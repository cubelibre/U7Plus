## Kernel/drivers/input/magnetometer/Kconfig
```kconfig
#
# Magnetometer sensors
#

menuconfig MAG_SENSORS
	bool "Magnetometer sensors"
	help
	  Say Y here, and a list of Magnetometer sensors drivers will be displayed.
	  Everything that didn't fit into the other categories is here. This option
	  doesn't affect the kernel.

	  If unsure, say Y.

if MAG_SENSORS

#wisky[s]cd huang@20120522
config WISKY_COMPASS_SENSOR
	bool "Wisky COMPASS Sensor support"
	depends on I2C
	default y
	help
	  To have support for your specific gsesnor you will have to
	  select the proper drivers which depend on this option.
#wisky[e]
config COMPASS_AK8975
  tristate "Asahi Kasei AK8975 3-Axis Magnetometer"
  depends on I2C
  help
  Say yes here to build support for Asahi Kasei AK8975 3-Axis
  Magnetometer.

  To compile this driver as a module, choose M here: the module
  will be called ak8975.

config COMPASS_AK8973
  tristate "Asahi Kasei AK8973 3-Axis Magnetometer"
  depends on I2C
  help
  Say yes here to build support for Asahi Kasei AK8973 3-Axis
  Magnetometer.

  To compile this driver as a module, choose M here: the module
  will be called ak8973.

 config COMPASS_MMC328X
  tristate "Mmc328x 3-Axis Magnetometer"
  depends on I2C
  help
  Say yes here to build support for mmc3280 3-Axis
  Magnetometer.

  To compile this driver as a module, choose M here: the module
  will be called mmc3280. 

endif
```

## Kernel/drivers/net/wireless/rkusbwifi/compat/Kconfig
```kconfig
config USB_WIFI_COMPAT
	tristate "USB WIFI compatible solution"
    select WIRELESS_EXT
    select WEXT_PRIV
    select IEEE80211
	---help---
	  Help message of RTL8188EU & RTL8189ES
```

## Kernel/drivers/switch/Kconfig
```kconfig
menuconfig SWITCH
	tristate "Switch class support"
	help
	  Say Y here to enable switch class support. This allows
	  monitoring switches by userspace via sysfs and uevent.

if SWITCH

choice
	prompt "Switch gpio:"
	default WISKY_SWITCH_GPIO
	
config WISKY_SWITCH_GPIO
	tristate "Wisky GPIO Swith support"
	help
	  Say Y here to enable GPIO based switch support.
	  
config SWITCH_GPIO
	tristate "GPIO Swith support"
	depends on GENERIC_GPIO
	help
	  Say Y here to enable GPIO based switch support.
endchoice

endif # SWITCH
```

## Kernel/drivers/video/hdmi/chips/Kconfig
```kconfig
choice
	prompt "HDMI chips select"
config RK610_HDMI
	bool "RK610(Jetta) hdmi support"
	depends on MFD_RK610
	help
		Support Jetta(RK610) to hdmi.
endchoice
```

## Kernel/drivers/video/rockchip/Kconfig
```kconfig
menuconfig FB_ROCKCHIP
        tristate "Frame buffer support for Rockchip "
        depends on FB
        select FB_CFB_FILLRECT
        select FB_CFB_COPYAREA
        select FB_CFB_IMAGEBLIT
        ---help---
          Framebuffer driver for rockchip based platform

config FB_WIMO
	bool "WiMO support"
	depends on FB_ROCKCHIP
	default n
	help
	    Support wimo

config LCDC_RK30
        tristate "rk30 lcdc support "
        depends on FB_ROCKCHIP
        help
          Driver for rk30 lcdc .There are two lcd controllers on rk30

config LCDC0_RK30
	bool "lcdc0 support"
	depends on LCDC_RK30
	default y
	help 
	   Support rk30 lcdc0 if you say y here

config LCDC1_RK30
        bool "lcdc1 support"
        depends on LCDC_RK30
        default y if HDMI_RK30
        help
           Support rk30 lcdc1 if you say y here

config DUAL_LCDC_DUAL_DISP_IN_KERNEL
        bool "implement dual display in kernel"
        depends on FB_ROCKCHIP
        default y if HDMI_RK30
        help
          select y will implement dual screen display in kernel
          
config FB_ROTATE
   bool"FB rotate support"
   depends on FB_ROCKCHIP
   default n
   help
     select y if you need rotate your screen

config ROTATE_ORIENTATION
   int "rotate orientation"
   depends on FB_ROTATE
   default 0
   help
     select 0, 90, 180,270 according to your Mold          
          
          
    
config ONE_LCDC_DUAL_OUTPUT_INF
        bool "one lcdc dual output display interface support"
       depends on FB_ROCKCHIP
        default y if ARCH_RK2928
        help
          select y if on platform like rk2928 which have one lcdc but two output interface

config THREE_FB_BUFFER
	bool "Three fb buffer support"
	depends on FB_ROCKCHIP
	default y
	help
	   select y if android support three buffer,like Jelly Bean
source "drivers/video/rockchip/hdmi/Kconfig"
source "drivers/video/rockchip/rga/Kconfig"
```
